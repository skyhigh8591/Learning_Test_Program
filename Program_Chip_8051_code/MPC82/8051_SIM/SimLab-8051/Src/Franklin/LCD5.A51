;
; 配合"文字型LCD實習板"
;   在文字型LCD上顯示"1998年10月16日"
;
E	EQU	P1.2
RW	EQU	P1.1
RS	EQU	P1.0

START:
	ACALL	DELAY5MS     ; wait for LCD Power-on Ready
	MOV	A,#0111111B  ;採用8位元資料存取/雙列字/5*10點矩陣字型
	ACALL	COMMAND
	MOV	A,#01110B   ;顯示器ON/游標被顯示在位址計數器
	ACALL	COMMAND
	MOV	A,#1     ;清除全螢幕
	ACALL	COMMAND

;      設定自定字型 年,月,日
	MOV	A,#001000000B   ;設定CG RAM位址為0
	ACALL	COMMAND
	MOV	DPTR,#CG
	MOV	R0,#3*8
LOOP1:
	CLR	A
	MOVC	A,@A+DPTR
	ACALL	SDATA
	INC	DPTR
	DJNZ	R0,LOOP1

	MOV	A,#010000000B   ;設定DD RAM位址為0
	ACALL	COMMAND
	MOV	DPTR,#MES
	MOV	R0,#11
LOOP2:
	CLR	A
	MOVC	A,@A+DPTR
	ACALL	SDATA
	INC	DPTR
	DJNZ	R0,LOOP2

	SJMP	$
COMMAND:
	MOV	P0,A
	SETB	E
	CLR	RW
	CLR	RS
	CLR	E
	SETB	RW
	ACALL	WAITLCD
	RET
SDATA:
	MOV	P0,A
	SETB	E
	CLR	RW
	SETB	RS
	CLR	E
	SETB	RW
WAITLCD:
	MOV	P0,#0FFH  ; P0設定為輸入
WAITLCD1:
	CLR	RS
	SETB	RW
	SETB	E
	MOV	A,P0
	CLR	E
	ANL	A,#80H
	JNZ	WAITLCD1
	RET
DELAY5MS:
	ACALL	DELAY1MS
	ACALL	DELAY2MS
	ACALL	DELAY2MS
	RET
DELAY2MS:
	ACALL	DELAY1MS
	ACALL	DELAY1MS
	RET

	$include (delay.inc)

MES:	DB	"1998",0,"10",1,"16",2
CG:	DB	010H , 01fH , 002H , 00fH , 00aH , 0ffH , 002H , 000H  ; 年
	DB	00fH , 009H , 00fH , 009H , 00fH , 009H , 013H , 000H  ; 月
	DB	00fH , 009H , 009H , 00fH , 009H , 009H , 00fH , 000H  ; 日

	END
