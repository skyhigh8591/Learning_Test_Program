;
;
;   Display "1998"nian"10"yue"16"ri"" on Text LCD
;
E	EQU	P1.2
RW	EQU	P1.1
RS	EQU	P1.0

START:
	ACALL	DELAY5MS     ; wait for LCD Power-on Ready
	MOV	A,#0111111B  ; 8 bits data bus/2 lines/5*10 dots
	ACALL	COMMAND
	MOV	A,#01110B   ; display ON
	ACALL	COMMAND
	MOV	A,#1     ;clear display
	ACALL	COMMAND

;      define font of  "nian" "yue" "ri"
	MOV	A,#001000000B   ;CG RAM address=0
	ACALL	COMMAND
	MOV	DPTR,#CG
	MOV	R0,#3*8
LOOP1:
	CLR	A
	MOVC	A,@A+DPTR
	ACALL	SDATA
	INC	DPTR
	DJNZ	R0,LOOP1

	MOV	A,#010000000B   ; DD RAM address=0
	ACALL	COMMAND
	MOV	DPTR,#MES
	MOV	R0,#11
LOOP2:
	CLR	A
	MOVC	A,@A+DPTR
	ACALL	SDATA
	INC	DPTR
	DJNZ	R0,LOOP2

	SJMP	$
COMMAND:
	MOV	P0,A
	SETB	E
	CLR	RW
	CLR	RS
	CLR	E
	SETB	RW
	ACALL	WAITLCD
	RET
SDATA:
	MOV	P0,A
	SETB	E
	CLR	RW
	SETB	RS
	CLR	E
	SETB	RW
WAITLCD:
	MOV	P0,#0FFH  ; P0 set to input port
WAITLCD1:
	CLR	RS
	SETB	RW
	SETB	E
	MOV	A,P0
	CLR	E
	ANL	A,#80H
	JNZ	WAITLCD1
	RET
DELAY5MS:
	ACALL	DELAY1MS
	ACALL	DELAY2MS
	ACALL	DELAY2MS
	RET
DELAY2MS:
	ACALL	DELAY1MS
	ACALL	DELAY1MS
	RET

	$include (delay.inc)

MES:	DB	"1998",0,"10",1,"16",2
CG:	DB	010H , 01fH , 002H , 00fH , 00aH , 0ffH , 002H , 000H  ; "nian"
	DB	00fH , 009H , 00fH , 009H , 00fH , 009H , 013H , 000H  ; "yue"
	DB	00fH , 009H , 009H , 00fH , 009H , 009H , 00fH , 000H  ; "ri"

	END
