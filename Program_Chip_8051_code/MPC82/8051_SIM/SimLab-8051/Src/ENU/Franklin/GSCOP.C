//
//   P0 control horizontal position(X),
//   P1 control vertical position(Y),
//     Display "HELLO !!" and  twinkle
//       	
//
#pragma oe db pw(80) SM SB CD
#include <reg51.h>

char code tbl[8][8]=
{
{0xc6, 0xc6, 0xc6, 0xfe, 0xc6, 0xc6, 0xc6, 0x00},
{0xfe, 0x62, 0x68, 0x78, 0x68, 0x62, 0xfe, 0x00},
{0xf0, 0x60, 0x60, 0x60, 0x60, 0x62, 0xfe, 0x00},
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{0x18, 0x3c, 0x3c, 0x18, 0x18, 0x00, 0x18, 0x00},
};


main()
{
	char t;
	int i,j, x=20, y=20;

	P0 =0;
	P1 =0;
	
	for(;;){
	    for(i=0;i<8 ;i++){
		for(j=0; j<8*8; j++){
		    t=tbl[j>>3][i];
		    t=t<<(j&7);
		    if(t&0x80){
			P0 = j+x;	
			P1 = i+y;
		    }
		}
	    }
	    P0=0;
	    P1=0;
	    for(i=0; i < 30000; i++);
	}
}
