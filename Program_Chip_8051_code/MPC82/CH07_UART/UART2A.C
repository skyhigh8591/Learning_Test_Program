/**********UART2A.c *******MODE1串列自我或兩台傳輸******************
*動作：計數值由TXD發射並在LED0顯示，同時由RXD腳接收在LED1顯示
*硬體：SW1-3(P0LED)及SW1-4(P1LED)ON，自我或兩台P31(TxD1)連接P30(RxD1)
*********************************************************/
#include "..\MPC82.H"   //暫存器及組態定義
main()
{
  unsigned char i;	//計數值
  P0M0=0; P0M1=0xFF; //設定P0為推挽式輸出(M0-1=01)
  UART_init(9600); //設定串列環境及鮑率
  while(1)	//重覆執行
  {
   	LED0=~i;	 //計數值由LED0輸出
	SBUF=i;	     //計數值串列發射出去
	while(TI==0);//若TI=0表示未發射完畢，再繼續檢查
	TI=0;		 //若TI=1表示已發射完畢，令TI=0

	while(RI==0);//若RI=0表示未接收完畢，再繼續檢查
    RI=0 ;	     //若RI=1表示已接收完畢，令RI=0
	LED1=~SBUF;	 //將接收到的計數值由LED1輸出
		
		i++;
		Delay_ma(500);
  }
}
/***********************************************************
*函數名稱: UART_init
*功能描述: UART啟始程式
*輸入參數：bps
************************************************************/
void UART_init(unsigned int bps)  //UART啟始程式
{
   SCON = 0x50;     //設定UART串列傳輸為MODE1及致能接收
   TMOD = 0x20;     //設定TIMER1為MODE2
   TH1 = 256-(57600/bps);  //設計時器決定串列傳輸鮑率
   TR1 = 1;          //開始計時
}