;
; 配合"文字型LCD實習板"
;   在文字型LCD上做單列字左(右)移
;
E	EQU	P1.2
RW	EQU	P1.1
RS	EQU	P1.0

START:
	ACALL	DELAY5MS     ; wait for LCD Power-on Ready
	MOV	A,#0110111B  ;採用8位元資料存取/單列字/5*10點矩陣字型
	ACALL	COMMAND
	MOV	A,#01110B   ;顯示器ON/游標被顯示在位址計數器
	ACALL	COMMAND
	MOV	A,#1     ;清除全螢幕
	ACALL	COMMAND
	ACALL	DELAY2MS
	MOV	A,#010000000B   ;設定DD RAM位址為0
	ACALL	COMMAND
	MOV	DPTR,#MES1
LOOP1:
	CLR	A
	MOVC	A,@A+DPTR
	JZ	ENDMES1
	ACALL	SDATA
	INC	DPTR
	SJMP	LOOP1
ENDMES1:
LOOP3:
	MOV	A,#18H     ;18H---左移/1CH---右移
	ACALL	COMMAND
	LCALL	Delay1s
	SJMP	LOOP3
COMMAND:
	MOV	P0,A
	SETB	E
	CLR	RW
	CLR	RS
	CLR	E
	ACALL	DELAY40US
	RET
SDATA:
	MOV	P0,A
	SETB	E
	CLR	RW
	SETB	RS
	CLR	E
DELAY40US:
	MOV	R1,#20
	DJNZ	R1,$
	RET

DELAY5MS:
 	ACALL	DELAY1MS
	ACALL	DELAY2MS
	ACALL	DELAY2MS
	RET
DELAY2MS:
	ACALL	DELAY1MS
	ACALL	DELAY1MS
	RET

	$include (delay.inc)

MES1:	DB	"0 1 2 3 4 5 6 7 8 9 10 11 12 13 14 15 16 17 18 19 20 21 22 23 24 25 26 27 28 29 ",0
	END
