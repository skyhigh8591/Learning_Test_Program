;
; 配合"文字型LCD實習板"
;   在文字型LCD上顯示"Hello!!"(用延遲的方式和LCD同步) 
;
START:
	ACALL	DELAY5MS     ; wait for LCD Power-on Ready
	MOV	A,#0111111B  ;採用8位元資料存取/雙列字/5*10點矩陣字型
	ACALL	COMMAND
	MOV	A,#01110B   ;顯示器ON/游標被顯示在位址計數器
	ACALL	COMMAND
	MOV	A,#1     ;清除全螢幕
	ACALL	COMMAND
	ACALL	DELAY2MS
	MOV	A,#010000000B   ;設定DD RAM位址為0
	ACALL	COMMAND
	MOV	DPTR,#MES
LOOP:
	CLR	A
	MOVC	A,@A+DPTR
	JZ	ENDMES
	ACALL	SDATA
	INC	DPTR
	SJMP	LOOP
ENDMES:
	SJMP	$
COMMAND:
	MOV	P0,A
	MOV	P1,#0100B    ;E=1 , RW=0 , RS=0
	MOV	P1,#0000B    ;E=0 , RW=0 , RS=0
	ACALL	DELAY40US
	RET
SDATA:
	MOV	P0,A
	MOV	P1,#0101B    ;E=1 , RW=0 , RS=1
	MOV	P1,#0001B    ;E=0 , RW=0 , RS=1
	ACALL	DELAY40US
	RET

DELAY40US:
	MOV	R1,#20
	DJNZ	R1,$
	RET
DELAY5MS:
	ACALL	DELAY1MS
	ACALL	DELAY2MS
	ACALL	DELAY2MS
	RET
DELAY2MS:
	ACALL	DELAY1MS
	ACALL	DELAY1MS
	RET

	$include (delay.inc)

MES:	DB	"Hello!!",0
	END
