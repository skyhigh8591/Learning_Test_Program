/************** LCD1.C **********************************
*以4 bits介面操作LCDM 
***********************************************/
#include "..\MPC82.H"   //暫存器及組態定義
void main(void)
{
   unsigned char i;        //資料計數
   LCD_init();    //重置及清除LCD    
   LCD_Cmd(0x83); //游標由第一行第4個字開始顯示
    
   for(i='0'; i<= '9';i++)//字元0~9 
    {
     LCD_Data(i);  //字元送到LCD顯示   
	}

   LCD_Cmd(0xC0); //游標由第二行第1個字開始顯示   
   for(i='A'; i<= 'P';i++)//LCD顯示字元A~P 
    {
	 LCD_Data(i);  //字元送到LCD顯示   
	}

	while(1)   //不停的循環執行
     {  //選擇以下其中功能來執行
 	   //LCD_Cmd(0x08); Delay_ms(500);//D=0關閉顯示器
       //LCD_Cmd(0x0c); Delay_ms(500);//D=1開啟顯示器
       //LCD_Cmd(0x1c); Delay_ms(100);//SC=1及RL=1顯示幕右移
       //LCD_Cmd(0x18); Delay_ms(100);//SC=1及RL=0顯示幕左移
     }  
}
/***********************************************************
*函數名稱: LCD_Data
*功能描述: 傳送資料到文字型LCD
*輸入參數：dat
************************************************************/
void EN_LCD(void)  //傳送到LCD
{
	EN=1;
	Delay_ms(1);	
	EN=0;
}
/***********************************************************
*函數名稱: LCD_Data
*功能描述: 傳送資料到文字型LCD
*輸入參數：dat
************************************************************/
void LCD_Data(unsigned char dat)  //傳送資料到LCD
{
	RS=1;	RW=0; 
	Data=dat;		EN_LCD();   //資料送到BUS
	Data=dat <<4;	EN_LCD();   //資料送到BUS
}
/***************************************************************
*函數名稱: LCD_Cmd
*功能描述: 傳送命令到文字型LCD
*輸入參數：Cmd
************************************************************/
void LCD_Cmd(unsigned char Cmd) //傳送命令到LCD
{
    RS=0;  RW=0;   
	Data=Cmd;		EN_LCD();       //命令送到BUS
	Data=Cmd<<4;	EN_LCD();      //命令送到BUS
}

/***************************************************************
*函數名稱: LCD_init
*功能描述: 啟始化文字型LCD
*****************************************************************/
void LCD_init(void)    //LCD的初始化程式  
{
	Delay_ms(50);		//LCD電源on時，等待電源穩定時間>40ms 
    RS=0;  RW=0;   

	Data=0X20;	EN_LCD();	//功能設定：採用4-bits 資料介面模式
	LCD_Cmd(0x28); 		//螢幕開啟，顯示2行字幕
	Delay_ms(1); 		//等待LCDM內部運作時間>39us

	LCD_Cmd(0x0E);		//設定螢幕on，游標開啟，游標不閃爍
	Delay_ms(1);		//等待LCDM內部運作時間>39us
	 
	LCD_Cmd(0x01);		//清除螢幕
	Delay_ms(2); 		//等待LCDM內部運作時間>1.5ms

	LCD_Cmd(0x06);
	LCD_Cmd(0x02);
	Delay_ms(4); 	   //初始化完成等待時間>3.5ms
    
}
