;
;
;   Display a horizontal line (at top)  on Graphic LCD
;
E	EQU	P1.2
RW	EQU	P1.1
DI	EQU	P1.0
CS1	EQU	P1.3
CS2	EQU	P1.4
SPAGE	EQU	R0

START:
	SETB	CS1
	CLR	CS2
	ACALL	DELAY5MS
	MOV	A,#0111111B  ; wait for LCD Power-on Ready & Display ON
	ACALL	COMMAND

	MOV	SPAGE,#7
LOOP:
	MOV	A,#010111000B   ;X addr=0
	ORL	A,SPAGE
	ACALL	COMMAND
	MOV	A,#001000000B   ;Y addr=0
	ACALL	COMMAND
	MOV	A,#0FFH
	ACALL	SDATA
	DEC	SPAGE
	CJNE	SPAGE,#0FFH,LOOP
	SJMP	$
COMMAND:
	MOV	P0,A
	SETB	E
	CLR	RW
	CLR	DI
	CLR	E
	SETB	RW
	ACALL	WAITLCD
	RET
SDATA:
	MOV	P0,A
	SETB	E
	CLR	RW
	SETB	DI
	CLR	E
	SETB	RW
WAITLCD:
	MOV	P0,#0FFH  ; P0 set to input port
WAITLCD1:
	CLR	DI
	SETB	RW
	SETB	E
	MOV	A,P0
	CLR	E
	ANL	A,#80H
	JNZ	WAITLCD1
	RET
DELAY5MS:
	ACALL	DELAY1MS
	ACALL	DELAY2MS
	ACALL	DELAY2MS
	RET
DELAY2MS:
	ACALL	DELAY1MS
	ACALL	DELAY1MS
	RET

	$include (delay.inc)

	END
