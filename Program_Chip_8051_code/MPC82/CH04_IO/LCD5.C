/****** LCD5.C ******* LCD顯示中文字型範例*******
*動作：由LCD顯示自創的資工字型 
***********************************************/
#include "..\MPC82.H"   //暫存器及組態定義
unsigned char code Table[]=   //自創資工字型
 {0x00,0x00,0x19,0x02,0x08,0x11,0x07,0x04,//資的左上字
  0x00,0x10,0x1f,0x09,0x14,0x02,0x1c,0x04,//資的右上字
  0x00,0x0f,0x00,0x00,0x00,0x00,0x01,0x01,//工的左上字
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  0x10,0x10,0x10,0x00,0x00,0x00,0x1f,0x00 //工的右下字
 };
main()
{   
  unsigned char i;   
    LCD_init();             //重置及清除LCD     
    for(i=0x0;i<=0x3f;i++) //寫入CGRAM位址
     {
       LCD_Cmd(0x40+i);    //指定CGRAM位址  
       LCD_Data(Table[i]); //寫入CGRAM資料  
     }        
    LCD_Cmd(0x80);	//指定第一行顯示的位址
    for(i=0;i<4;i++)   LCD_Data(i);//讀取CGROM位址0-3的自創圖形資料    
     LCD_Cmd(0xc0);	//指定第二行顯示的位址
    for(i=4;i<8;i++)  LCD_Data(i);	//讀取CGROM位址4-7的自創圖形資料   
   while(1);  //停止
 } 
/***********************************************************
*函數名稱: LCD_Data
*功能描述: 傳送資料到文字型LCD
*輸入參數：dat
************************************************************/
void LCD_Data(unsigned char dat)  //傳送資料到LCD
{
    unsigned char dly=5;
	Data=dat;      //資料送到BUS
    RS=1;RW=0;EN=1;//資料寫入到LCD內
    while(dly--);
	EN=0;          //禁能LCD 
	LCD_wait();    //LCD等待寫入完成  
}
/***************************************************************
*函數名稱: LCD_Cmd
*功能描述: 傳送命令到文字型LCD
*輸入參數：Cmd
************************************************************/
void LCD_Cmd(unsigned char Cmd) //傳送命令到LCD
{
    unsigned char dly=5;
	Data=Cmd;       //命令送到BUS
    RS=0;RW=0;EN=1; //命令寫入到LCD內
    while(dly--);
    EN=0;           //禁能LCD
	LCD_wait(); //LCD等待寫入完成 
}
/***************************************************************
*函數名稱: LCD_Cmd
*功能描述: 傳送命令到文字型LCD
*輸入參數：Cmd
************************************************************/
void LCD_Cmd_Init(unsigned char Cmd) //傳送命令到LCD
{
	Data=Cmd;       //命令送到BUS
    RS=0;RW=0;EN=1; //命令寫入到LCD內
    Delay_ms(1);
    EN=0;           //禁能LCD
    Delay_ms(1);
}
/***************************************************************
*函數名稱: LCD_init
*功能描述: 啟始化文字型LCD
*****************************************************************/
void LCD_init(void)    //LCD的啟始程式  
{
    LCD_Cmd_Init(0x38);//0011 1000,8bit傳輸,顯示2行,5*7字型
    LCD_Cmd_Init(0x38);//bit4:DL=1,8bit傳輸,
    LCD_Cmd_Init(0x38);//bit3:N=1,顯示2行
                       //bit2:F=0,5*7字型    
    LCD_Cmd_Init(0x0c);/*0000 1100,顯示幕ON,不顯示游標,游標不閃爍
                    bit2:D=1,顯示幕ON
                    bit1:C=0,不顯示游標
	                bit0:B=0,游標不閃爍*/
    LCD_Cmd_Init(0x06);/*0000 0110,//顯示完游標右移,游標移位禁能 
                    bit1:I/D=1,顯示完游標右移,
                    bit0:S=0,游標移位禁能*/  
    LCD_Cmd_Init(0x01); //清除顯示幕  
    LCD_Cmd_Init(0x02); //游標回原位  
}
/**************************************************
*函數名稱: LCD_wait
*功能描述: LCD等待忙碌旗標BF
****************************************************/
void LCD_wait(void)
{
  unsigned char status;  //定義LCD讀取狀態
  Data=0xff; //P0設定為輸入埠
  do
  {
    RS=0;RW=1;EN=1;//讀取命令
    status= Data;	//輸入LCD的命令
    EN=0;			//禁能LCD
  }
  while(status & 0x80); //等待忙碌旗標BF=0
}
