;
; 配合"繪圖型LCD(橫排)實習板"
;   在繪圖型LCD上方顯示一橫線
;
E	REG	P1.2
RW	REG	P1.1
DI	REG	P1.0
CS1	REG	P1.3
CS2	REG	P1.4

START:
	SETB	CS1
	SETB	CS2
	ACALL	DELAY5MS
	MOV	A,#0111111B  ; wait for LCD Power-on Ready & Display ON
	ACALL	COMMAND

	MOV	A,#010111000B   ;設定X addr=0
	ACALL	COMMAND
	MOV	A,#001000000B   ;設定Y addr=0
	ACALL	COMMAND
	MOV	R0,#64
LOOP:
	MOV	A,#01H
	ACALL	SDATA
	DJNZ	R0,LOOP
	SJMP	$
COMMAND:
	MOV	P0,A
	SETB	E
	CLR	RW
	CLR	DI
	CLR	E
	SETB	RW
	ACALL	WAITLCD
	RET
SDATA:
	MOV	P0,A
	SETB	E
	CLR	RW
	SETB	DI
	CLR	E
	SETB	RW
WAITLCD:
	MOV	P0,#0FFH  ; P0設定為輸入埠
WAITLCD1:
	CLR	DI
	SETB	RW
	SETB	E
	MOV	A,P0
	CLR	E
	ANL	A,#80H
	JNZ	WAITLCD1
	RET
DELAY5MS:
	ACALL	DELAY1MS
	ACALL	DELAY2MS
	ACALL	DELAY2MS
	RET
DELAY2MS:
	ACALL	DELAY1MS
	ACALL	DELAY1MS
	RET

	include delay.inc

	END
