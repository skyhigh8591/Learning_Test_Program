//
//  配合"4個8*8彩色點矩陣LED實習板"
//   在16*16彩色點矩陣LED上依序顯示紅色的"歡",綠色的"迎",橙色的"參"紅色的"觀"
/
//
#pragma oe db pw(80) SM SB CD
#include	<reg51.h>
#include "Delay.h"
unsigned char code hwan[]= {
	0xFF,0xFF,              //歡
	0xDF,0xEF,
	0xD1,0x9F,
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	0xFF,0xFD,

} ;
sbit CTRLLED= P2^0 ;
sbit LRED1=P1^4 ;
sbit LGREEN1=P1^5 ;
sbit LRED2=P1^6 ;
sbit LGREEN2=P1^7 ;
#define BASEINT	25
#define INTERVAL1	BASEINT*1
#define INTERVAL2	BASEINT*2
#define INTERVAL3	BASEINT*3
#define INTERVAL4	BASEINT*4
main()
{
	char idx ;
	unsigned int interval ;
	unsigned char color ;
	unsigned char woffset ;
	idx=0 ;
	woffset=0 ;
	interval=0 ;
	color=0 ;
	for( ; ;){
	    CTRLLED=1 ;
	    if((color== 0) || (color== 2)){
 		P0=hwan[woffset+idx*2] ;
		LRED1=0 ;
		LRED1=1 ;
		P0=hwan[woffset+idx*2+1] ;
		LRED2=0 ;
		LRED2=1 ;
	    }
	    else{
		P0=0xff ;
		LRED1=0 ;
		LRED1=1 ;
		LRED2=0 ;
		LRED2=1 ;
	    }
	    if((color == 1) || (color== 2)){
 		P0=hwan[woffset+idx*2] ;
		 LGREEN1=0 ;
		LGREEN1=1 ;
		P0=hwan[woffset+idx*2+1] ;
		LGREEN2=0 ;
		LGREEN2=1 ;
	    }
	    else{
		P0=0xff ;
		LGREEN1=0 ;
		LGREEN1=1 ;
		LGREEN2=0 ;
		LGREEN2=1 ;
	    }

	    P1 &=0xf0 ;
	    P1 |=(idx &0xf);
	    CTRLLED=0 ;
	    idx++ ;
	    if(idx ==16){
		interval++ ;
		idx=0 ;
	    }
	    if(interval ==  INTERVAL1){
		color=1 ;
		woffset=1*32 ;
	    }
	    else if(interval == INTERVAL2){
		color=2 ;
		woffset=2*32 ;
	    }
	    else if(interval == INTERVAL3){
		color=0 ;
		woffset=3*32 ;
	    }
	    else if(interval == INTERVAL4){
		interval=0 ;
		color=0 ;
		woffset=0 ;
	    }
	    Delay1ms() ;
	}
}
