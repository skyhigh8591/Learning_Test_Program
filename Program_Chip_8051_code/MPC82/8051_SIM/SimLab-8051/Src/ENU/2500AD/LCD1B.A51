;
;
;   Display "Hello!!" on Text LCD (synchronize by delay method)
;
START:
	ACALL	DELAY5MS     ; wait for LCD Power-on Ready
	MOV	A,#0111111B  ; 8 bits data bus/2 lines/5*10 dots
	ACALL	COMMAND
	MOV	A,#01110B    ; display ON
	ACALL	COMMAND
	MOV	A,#1     ;clear display
	ACALL	COMMAND
	ACALL	DELAY2MS
	MOV	A,#010000000B   ;DD RAM address =0
	ACALL	COMMAND
	MOV	DPTR,#MES
LOOP:
	CLR	A
	MOVC	A,@A+DPTR
	JZ	ENDMES
	ACALL	SDATA
	INC	DPTR
	SJMP	LOOP
ENDMES:
	SJMP	$
COMMAND:
	MOV	P0,A
	MOV	P1,#0100B    ;E=1 , RW=0 , RS=0
	MOV	P1,#0000B    ;E=0 , RW=0 , RS=0
	ACALL	DELAY40US
	RET
SDATA:
	MOV	P0,A
	MOV	P1,#0101B    ;E=1 , RW=0 , RS=1
	MOV	P1,#0001B    ;E=0 , RW=0 , RS=1
;	ACALL	DELAY40US
;	RET

DELAY40US:
	MOV	R1,#20
	DJNZ	R1,$
	RET
DELAY5MS:
	ACALL	DELAY1MS
	ACALL	DELAY2MS
	ACALL	DELAY2MS
	RET
DELAY2MS:
	ACALL	DELAY1MS
	ACALL	DELAY1MS
	RET

	include delay.inc

MES:	DB	"Hello!!",0
	END
